## board/asus/grouper/Kconfig
```kconfig
if TARGET_GROUPER

config SYS_BOARD
	default "grouper"

config SYS_VENDOR
	default "asus"

config SYS_CONFIG_NAME
	default "grouper"

config GROUPER_TPS65911
	bool "Enable support TI TPS65911 PMIC"
	default n

config GROUPER_MAX77663
	bool "Enable support MAXIM MAX77663 PMIC"
	default n

endif
```

## board/asus/transformer-t30/Kconfig
```kconfig
if TARGET_TRANSFORMER_T30

config SYS_BOARD
	default "transformer-t30"

config SYS_VENDOR
	default "asus"

config SYS_CONFIG_NAME
	default "transformer-t30"

config TRANSFORMER_SPI_BOOT
	bool "Enable support for SPI based flash"
	default n
	help
	  Tegra 3 based Transformers with Windows RT have core
	  boot sequence (BCT, PT, EBT) on separate SPI FLASH
	  memory with 4MB size.

config TRANSFORMER_TF700T_MIPI
	bool "Enable support for TF700T MIPI panel configuration"
	default n
	help
	  TF700T has different panel configuration then other
	  Transformers and uses I2C bridge.

endif
```

## configs/x3_t30_defconfig
```kconfig
CONFIG_ARM=y
CONFIG_SYS_L2CACHE_OFF=y
CONFIG_ARCH_TEGRA=y
CONFIG_SUPPORT_PASSING_ATAGS=y
CONFIG_CMDLINE_TAG=y
CONFIG_INITRD_TAG=y
CONFIG_TEXT_BASE=0x80110000
CONFIG_NR_DRAM_BANKS=2
CONFIG_ENV_SIZE=0x3000
CONFIG_ENV_OFFSET=0xFFFFD000
CONFIG_DEFAULT_DEVICE_TREE="tegra30-lge-x3"
CONFIG_SPL_TEXT_BASE=0x80108000
CONFIG_SYS_PROMPT="Tegra30 (x3) # "
CONFIG_TEGRA_CRYPTO=y
CONFIG_TEGRA_LEGACY_PT=y
CONFIG_TEGRA30=y
CONFIG_TARGET_X3_T30=y
CONFIG_SYS_LOAD_ADDR=0x81000000
CONFIG_DEBUG_LL=y
CONFIG_DEBUG_UART_PHYS=0x70006300
CONFIG_OF_BOARD_SETUP=y
CONFIG_OF_SYSTEM_SETUP=y
CONFIG_BOOTDELAY=0
CONFIG_AUTOBOOT_KEYED=y
CONFIG_AUTOBOOT_KEYED_CTRLC=y
CONFIG_SPL_FOOTPRINT_LIMIT=y
CONFIG_SPL_MAX_FOOTPRINT=0x8000
# CONFIG_SPL_SHARES_INIT_SP_ADDR is not set
CONFIG_SPL_STACK=0x800ffffc
CONFIG_SYS_SPL_MALLOC=y
CONFIG_HAS_CUSTOM_SPL_MALLOC_START=y
CONFIG_CUSTOM_SYS_SPL_MALLOC_ADDR=0x80090000
CONFIG_SYS_SPL_MALLOC_SIZE=0x10000
CONFIG_SYS_MAXARGS=64
CONFIG_SYS_PBSIZE=2084
CONFIG_CMD_BOOTMENU=y
# CONFIG_CMD_IMI is not set
CONFIG_CMD_GPIO=y
CONFIG_CMD_I2C=y
CONFIG_CMD_MMC=y
CONFIG_CMD_POWEROFF=y
CONFIG_CMD_USB=y
CONFIG_CMD_USB_MASS_STORAGE=y
# CONFIG_CMD_SETEXPR is not set
# CONFIG_CMD_NFS is not set
CONFIG_CMD_EXT4_WRITE=y
# CONFIG_SPL_DOS_PARTITION is not set
# CONFIG_SPL_EFI_PARTITION is not set
CONFIG_ENV_OVERWRITE=y
CONFIG_SYS_RELOC_GD_ENV_ADDR=y
CONFIG_SYS_MMC_ENV_PART=2
CONFIG_SPL_DM=y
CONFIG_USB_FUNCTION_FASTBOOT=y
CONFIG_FASTBOOT_BUF_ADDR=0x91000000
CONFIG_FASTBOOT_BUF_SIZE=0x10000000
CONFIG_FASTBOOT_FLASH=y
CONFIG_FASTBOOT_FLASH_MMC_DEV=0
CONFIG_SYS_I2C_TEGRA=y
CONFIG_GPIO_KEYBOARD=y
CONFIG_EXTCON_MAX14526=y
CONFIG_DM_PMIC=y
CONFIG_DM_REGULATOR=y
CONFIG_DM_REGULATOR_FIXED=y
CONFIG_PWM_TEGRA=y
CONFIG_SYS_NS16550=y
CONFIG_TEGRA20_SLINK=y
CONFIG_USB=y
CONFIG_USB_EHCI_HCD=y
CONFIG_USB_EHCI_TEGRA=y
CONFIG_USB_KEYBOARD=y
CONFIG_USB_GADGET=y
CONFIG_USB_GADGET_MANUFACTURER="LGE"
CONFIG_USB_GADGET_VENDOR_NUM=0x1004
CONFIG_USB_GADGET_PRODUCT_NUM=0x7100
CONFIG_CI_UDC=y
CONFIG_VIDEO=y
# CONFIG_VIDEO_LOGO is not set
CONFIG_VIDEO_TEGRA20=y
CONFIG_BACKLIGHT_LM3533=y
CONFIG_BRIDGE_SOLOMON_SSD2825=y
CONFIG_CONSOLE_RECORD=y
CONFIG_CONSOLE_RECORD_OUT_SIZE=0x10000
CONFIG_FASTBOOT_CMD_OEM_CONSOLE=y
CONFIG_FASTBOOT_CMD_OEM_CMD=y
```

## drivers/misc/extcon/Kconfig
```kconfig
config EXTCON_MAX14526
	bool "Maxim MAX14526 EXTCON Support"
	select DM_I2C
	select DM_MISC
	help
	  If you say yes here you get support for the MUIC device of
	  Maxim MAX14526. The MAX14526 MUIC is a USB port accessory
	  detector and switch.
```

## drivers/video/lge-x3/Kconfig
```kconfig
config BACKLIGHT_LM3533
	bool "Backlight Driver for LM3533"
	depends on BACKLIGHT
	select DM_I2C
	help
	  Say Y to enable the backlight driver for National Semiconductor / TI
	  LM3533 Lighting Power chips.
```
